## firmware/main/Kconfig.projbuild
```kconfig
menu "ESPClaw"

choice ESPCLAW_BOARD_PROFILE
    prompt "ESPClaw board profile"
    default ESPCLAW_BOARD_PROFILE_ESP32S3

config ESPCLAW_BOARD_PROFILE_ESP32S3
    bool "ESP32-S3"

config ESPCLAW_BOARD_PROFILE_ESP32CAM
    bool "ESP32-CAM"

config ESPCLAW_BOARD_PROFILE_ESP32C3
    bool "ESP32-C3"
endchoice

choice ESPCLAW_STORAGE_BACKEND
    prompt "ESPClaw workspace storage backend"
    default ESPCLAW_STORAGE_BACKEND_AUTO

config ESPCLAW_STORAGE_BACKEND_AUTO
    bool "Auto (use board profile default)"

config ESPCLAW_STORAGE_BACKEND_SD
    bool "SD card"

config ESPCLAW_STORAGE_BACKEND_LITTLEFS
    bool "LittleFS on internal flash"
endchoice

config ESPCLAW_ENABLE_SD_BOOTSTRAP
    bool "Enable SD mount and workspace bootstrap"
    default y

config ESPCLAW_SD_MOUNT_POINT
    string "SD mount point"
    default "/sdcard"

config ESPCLAW_SD_SPI_MOSI
    int "SDSPI MOSI pin"
    default -1

config ESPCLAW_SD_SPI_MISO
    int "SDSPI MISO pin"
    default -1

config ESPCLAW_SD_SPI_SCLK
    int "SDSPI SCLK pin"
    default -1

config ESPCLAW_SD_SPI_CS
    int "SDSPI CS pin"
    default -1

config ESPCLAW_FLASH_MOUNT_POINT
    string "Flash workspace mount point"
    default "/workspace"

config ESPCLAW_FLASH_PARTITION_LABEL
    string "Flash workspace partition label"
    default "workspace"

config ESPCLAW_ENABLE_WIFI_PROVISIONING
    bool "Enable Wi-Fi provisioning"
    default y

config ESPCLAW_ENABLE_TELEGRAM
    bool "Enable Telegram polling"
    default y

config ESPCLAW_TELEGRAM_BOT_TOKEN
    string "Telegram bot token"
    default ""

config ESPCLAW_TELEGRAM_POLL_INTERVAL_SECONDS
    int "Telegram poll interval"
    range 1 60
    default 5

endmenu
```

## firmware/sdkconfig.defaults
```kconfig
CONFIG_ESPTOOLPY_FLASHSIZE_4MB=y
CONFIG_ESP_MAIN_TASK_STACK_SIZE=10240
CONFIG_LWIP_MAX_SOCKETS=16
CONFIG_PARTITION_TABLE_CUSTOM=y
CONFIG_PARTITION_TABLE_CUSTOM_FILENAME="partitions_espclaw.csv"
CONFIG_PARTITION_TABLE_FILENAME="partitions_espclaw.csv"
```

## firmware/sdkconfig.defaults.esp32
```kconfig
CONFIG_ESPCLAW_BOARD_PROFILE_ESP32CAM=y
CONFIG_ESPCLAW_STORAGE_BACKEND_AUTO=y
CONFIG_SPIRAM=y
CONFIG_SPIRAM_BOOT_INIT=y
CONFIG_SPIRAM_USE_MALLOC=y
CONFIG_SPIRAM_TYPE_AUTO=y
CONFIG_SPIRAM_SPEED_40M=y
CONFIG_SPIRAM_TRY_ALLOCATE_WIFI_LWIP=y
CONFIG_MBEDTLS_EXTERNAL_MEM_ALLOC=y
CONFIG_MBEDTLS_DYNAMIC_FREE_CONFIG_DATA=y
# CONFIG_OV7670_SUPPORT is not set
# CONFIG_OV7725_SUPPORT is not set
# CONFIG_NT99141_SUPPORT is not set
CONFIG_OV2640_SUPPORT=y
# CONFIG_OV3660_SUPPORT is not set
# CONFIG_OV5640_SUPPORT is not set
# CONFIG_GC2145_SUPPORT is not set
# CONFIG_GC032A_SUPPORT is not set
# CONFIG_GC0308_SUPPORT is not set
# CONFIG_BF3005_SUPPORT is not set
# CONFIG_BF20A6_SUPPORT is not set
# CONFIG_SC030IOT_SUPPORT is not set
# CONFIG_HM1055_SUPPORT is not set
# CONFIG_HM0360_SUPPORT is not set
# CONFIG_MEGA_CCM_SUPPORT is not set
CONFIG_SCCB_HARDWARE_I2C_DRIVER_LEGACY=y
# CONFIG_SCCB_HARDWARE_I2C_DRIVER_NEW is not set
# CONFIG_SPIRAM_CACHE_LIBJMP_IN_IRAM is not set
# CONFIG_SPIRAM_CACHE_LIBMATH_IN_IRAM is not set
# CONFIG_SPIRAM_CACHE_LIBNUMPARSER_IN_IRAM is not set
# CONFIG_SPIRAM_CACHE_LIBIO_IN_IRAM is not set
# CONFIG_SPIRAM_CACHE_LIBTIME_IN_IRAM is not set
# CONFIG_SPIRAM_CACHE_LIBCHAR_IN_IRAM is not set
# CONFIG_SPIRAM_CACHE_LIBMEM_IN_IRAM is not set
# CONFIG_SPIRAM_CACHE_LIBSTR_IN_IRAM is not set
# CONFIG_SPIRAM_CACHE_LIBRAND_IN_IRAM is not set
# CONFIG_SPIRAM_CACHE_LIBENV_IN_IRAM is not set
# CONFIG_SPIRAM_CACHE_LIBFILE_IN_IRAM is not set
# CONFIG_SPIRAM_CACHE_LIBMISC_IN_IRAM is not set
CONFIG_FATFS_LFN_HEAP=y
CONFIG_FATFS_API_ENCODING_UTF_8=y
```

## firmware/sdkconfig.defaults.esp32c3
```kconfig
CONFIG_ESPCLAW_BOARD_PROFILE_ESP32C3=y
CONFIG_ESPCLAW_STORAGE_BACKEND_LITTLEFS=y
CONFIG_BT_ENABLED=y
CONFIG_BT_NIMBLE_ENABLED=y
```
